// SPDX-License-Identifier: GPL-2.0-only
/*
 * Battery device tree entries
 *
 * Copyright 2023 Google LLC
 *
 */

max77779,config {

	/* b/294426849 update Config2 */
	max77779,atl-1k {
		max77779,batt-id-kohm = <1>;
		max77779,model-version = <4>;
		max77779,force-reset-model-data;
		max77779,fg-model = /bits/ 16 <
                        0xA500 0xAE30 0xB720 0xBA50 0xBCB0 0xBE40 0xBFB0 0xC0B0
                        0xC280 0xC6C0 0xC970 0xCE80 0xD1C0 0xD470 0xDA60 0xDEB0
                        0x0080 0x0210 0x0D00 0x0F70 0x1A00 0x0D90 0x14D0 0x0A50
                        0x0970 0x07A0 0x06E0 0x05F0 0x05F0 0x07F0 0x04E0 0x04E0
		>;
		max77779,fg-params = /bits/ 16 <
			/* 0x0036 */	0xc1b0	/* nnvcfg0 */
			/* 0x002a */	0x043c	/* RelaxCFG */
			/* 0x002F */	0x260e	/* LearnCFG */
			/* 0x000C */	0x4207	/* Config */
			/* 0x00AB */	0x0080	/* Config2 */
			/* 0x0013 */	0x5a05	/* FullSOCthr */
			/* 0x0010 */	0x01e2	/* FullCAPRep */
			/* 0x00B3 */	0x01e2	/* nDesignCap */
			/* 0x0046 */	0x0c80	/* dPacc */
			/* 0x00A5 */	0x01e2	/* nFullCAPNom */
			/* 0x00C6 */	0xa55a	/* nV_empty */
			/* 0x0012 */	0x1f00	/* QResidual00 */
			/* 0x0022 */	0x0e80	/* QResidual10 */
			/* 0x0032 */	0x0680	/* QResidual20 */
			/* 0x0042 */	0x0580	/* QResidual30 */
			/* 0x00A6 */	0x0520	/* RCOMP0 */
			/* 0x00A7 */	0x1402	/* TempCo */
			/* 0x0029 */	0x0097	/* ICHGTerm */
			/* 0x00B2 */	0x3870	/* nMiscCFG */
			/* 0x009E */	0x0400	/* nModelCfg */
			/* 0x00CA */	0x58EF	/* nThermCfg */
			/* 0x009D */	0xCEA4	/* nFilterCfg */
		>;
	};

	/* b/294426849 update Config2 */
	max77779,cos-2k {
		max77779,batt-id-kohm = <2>;
		max77779,model-version = <4>;
		max77779,force-reset-model-data;
		max77779,fg-model = /bits/ 16 <
                        0xA4F0 0xB040 0xB7A0 0xB940 0xBAF0 0xBDA0 0xBEA0 0xC070
                        0xC490 0xC840 0xCAD0 0xCE20 0xD130 0xD550 0xD860 0xDEA0
                        0x0020 0x0310 0x1410 0x0A10 0x0F80 0x1A10 0x0F00 0x0BE0
                        0x05D0 0x09B0 0x05F0 0x0810 0x05A0 0x08E0 0x06A0 0x06A0
		>;
		max77779,fg-params = /bits/ 16 <
			/* 0x0036 */	0xc1b0	/* nnvcfg0 */
			/* 0x002a */	0x043c	/* RelaxCFG */
			/* 0x002F */	0x260e	/* LearnCFG */
			/* 0x000C */	0x4207	/* Config */
			/* 0x00AB */	0x0080	/* Config2 */
			/* 0x0013 */	0x5a05	/* FullSOCthr */
			/* 0x0010 */	0x01e2	/* FullCAPRep */
			/* 0x00B3 */	0x01e2	/* nDesignCap */
			/* 0x0046 */	0x0c80	/* dPacc */
			/* 0x00A5 */	0x01e2	/* nFullCAPNom */
			/* 0x00C6 */	0xa55a	/* nV_empty */
			/* 0x0012 */	0x1900	/* QResidual00 */
			/* 0x0022 */	0x0b00	/* QResidual10 */
			/* 0x0032 */	0x0480	/* QResidual20 */
			/* 0x0042 */	0x0400	/* QResidual30 */
			/* 0x00A6 */	0x04e0	/* RCOMP0 */
			/* 0x00A7 */	0x1202	/* TempCo */
			/* 0x0029 */	0x0097	/* ICHGTerm */
			/* 0x00B2 */	0x3870	/* nMiscCFG */
			/* 0x009E */	0x0400	/* nModelCfg */
			/* 0x00CA */	0x58EF	/* nThermCfg */
			/* 0x009D */	0xCEA4	/* nFilterCfg */
		>;
	};
};
