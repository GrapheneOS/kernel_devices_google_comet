// SPDX-License-Identifier: GPL-2.0-only
/*
 * Wireless Charger config for P9222.
 * Intended to be included into the approriate I2C bus.
 *
 * Copyright 2023 Google LLC
 */
p9222: p9222@61 {
	dev-name = "p9222";
	compatible = "idt,p9222";
	reg = <0x61>;
	status = "ok";

	/* Support p9412 GPIO */
	idt,has_p9412_gpio;

	idt,has_rtx = <0>;

	google,power_mitigate_threshold = <90>;
	google,has-sw-ramp;
	google,epp_dcicl_default_ma = <750000>;

	pinctrl-names = "default";
	pinctrl-0 = <&wc_irq &wc_en>;

	idt,max_vout_mv = <10000>;  /* max voltage in mV */

	p9xxx_gpio: p9xxx_gpio {
		gpio-controller;
		#gpio-cells = <2>;
		ngpios = <16>;
	};
};
