// SPDX-License-Identifier: GPL-2.0-only
/*
 * Comet board device tree source
 *
 * Copyright 2022 Google LLC
 */

#include "zuma-comet-board.dtsi"

#include "zuma-comet-audio-ti.dtsi"
#include "zuma-comet-camera.dtsi"
#include "zuma-comet-display.dtsi"
#include "zuma-comet-haptics.dtsi"
#include "zuma-comet-touch.dtsi"
#include "zuma-comet-thermal.dtsi"
#include "zuma-comet-bluetooth.dtsi"
#include "zuma-comet-pmic.dtsi"
