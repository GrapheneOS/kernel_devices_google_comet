// SPDX-License-Identifier: GPL-2.0-only
/*
 * Wireless Charger config for P9222.
 * Intended to be included into the approriate I2C bus.
 *
 * Copyright 2023 Google LLC
 */
p9222: p9222@61 {
	status = "disabled";
	compatible = "idt,p9222";
	reg = <0x61>;

	dev-name = "p9222";

	/* Support p9412 GPIO */
	idt,has_p9412_gpio;

	idt,has_rtx = <0>;

	google,power_mitigate_threshold = <90>;
	google,has-sw-ramp;
	google,epp_dcicl_default_ma = <750000>;

	pinctrl-names = "default";

	idt,max_vout_mv = <10000>;  /* max voltage in mV */

	google,q_value = <55>;
	google,rf_value = <91>;
	fod = [A6 25 6C 4B 97 14 91 1E AC D6 A5 E9 00 00 00 28];
	fod_epp = [93 42 79 6E 98 11 92 1A 94 07 A5 89 00 00 00 28];

	p9xxx_gpio: p9xxx_gpio {
		gpio-controller;
		#gpio-cells = <2>;
		ngpios = <16>;
	};
};
