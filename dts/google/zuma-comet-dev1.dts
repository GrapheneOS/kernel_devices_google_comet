// SPDX-License-Identifier: GPL-2.0-only
/*
 * Comet board device tree source
 *
 * Copyright 2022 Google LLC
 */

/dts-v1/;
/plugin/;

#include "zuma-comet-common.dtsi"

/ {
	board_id = <0x40601>;
	board_rev = <0x010000>;
	fragment@boardbase {
		target-path = "/";
		__overlay__ {
			model = "ZUMA COMET DEV 1.0 board based on ZUMA";
			compatible = "google,ZUMA COMET", "google,ZUMA";
		};
	};
};
