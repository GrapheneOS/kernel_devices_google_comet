// SPDX-License-Identifier: GPL-2.0-only
/*
 * Comet board device tree source
 *
 * Copyright 2024 Google LLC
 */

/dts-v1/;
/plugin/;

#include "zumapro-comet-common.dtsi"
#include "zuma-comet-bcl.dtsi"
#include "zuma-comet-typec.dtsi"
#include "google-dts-base/zumapro-board-cp-s5400-sit.dtsi"
#include "google-dts-base/zumapro-board-pcie-cp-s5400-a0.dtsi"
#include "google-dts-base/zuma-cp-s5400-phone-gnss.dtsi"
#include "zuma-comet-touch.dtsi"
#include "zuma-comet-outer-touch-proto1.dtsi"
#include "zuma-comet-audio.dtsi"
#include "zuma-comet-fingerprint.dtsi"
#include "zuma-comet-camera-pmic.dtsi"
#include "zuma-comet-camera.dtsi"
#include "zuma-comet-wlan.dtsi"

/ {
	board_id = <0x60603>;
	board_rev = <0x010000>;
	fragment@boardbase {
		target-path = "/";
		__overlay__ {
			model = "ZUMA PRO COMET EVT 1.0 Samsung GNSS board based on ZUMA PRO";
			compatible = "google,ZUMA PRO COMET", "google,ZUMA PRO";
		};
	};
};
